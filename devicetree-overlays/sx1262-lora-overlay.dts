/dts-v1/;
/plugin/;

#include <dt-bindings/pinctrl/rockchip.h>

/*
 * Device tree overlay for Waveshare SX1262HF LoRA module
 * 
 * This overlay configures GPIO pins for bitbang SPI communication with
 * the SX1262 LoRA transceiver module on the RMII1 test pads.
 * 
 * Pin Assignment (RMII1 test pads):
 *   GPIO3_B2 (Pin 30) → CLK  (UART5_CTSN - CTS not needed for GPS)
 *   GPIO3_B5 (Pin 27) → MOSI (UART5_RTSN - RTS not needed for GPS)
 *   GPIO3_A6 (Pin 34) → MISO (SAI2_SDI_M0 - non-UART pin)
 *   GPIO3_B6 (Pin 26) → DIO1 (Interrupt - SAI2_MCLK)
 *   GPIO1_D0 (Pin 115)→ BUSY (Module status - VO_LCDC_D3)
 *   GND                → CS   (Chip Select - tied permanently)
 *   3.3V+10kΩ         → RESET (Tied HIGH - no pin needed)
 * 
 * Note: UART5_TX (GPIO3_B4) and UART5_RX (GPIO3_B3) are preserved
 * for future GPS module connection.
 * 
 * The SX1262 module is controlled via software SPI (GPIO bitbang) at 2 MHz,
 * which is fast enough for LoRA communication.
 * 
 * To apply this overlay at runtime:
 *   mkdir -p /sys/kernel/config/device-tree/overlays/sx1262
 *   cat /boot/devicetree/sx1262-lora.dtbo > /sys/kernel/config/device-tree/overlays/sx1262/dtbo
 *   echo 1 > /sys/kernel/config/device-tree/overlays/sx1262/status
 * 
 * To remove:
 *   echo 0 > /sys/kernel/config/device-tree/overlays/sx1262/status
 *   rmdir /sys/kernel/config/device-tree/overlays/sx1262
 */

/ {
    compatible = "rockchip,rk3506";

    fragment@0 {
        target-path = "/";
        __overlay__ {
            /* LoRA device node for Meshtastic */
            sx1262_lora: lora {
                compatible = "semtech,sx1262";
                status = "okay";
                
                /* SPI bitbang configuration - handled by Meshtastic daemon */
                spi_speed = <2000000>; /* 2 MHz */
                
                /* GPIO pin assignments for Meshtastic meshtasticd daemon */
                /* These are exposed for user-space control */
            };
        };
    };

    /* Pin configuration for LoRA SPI and control signals */
    fragment@1 {
        target = <&pinctrl>;
        __overlay__ {
            sx1262_pins: sx1262-pins {
                /*
                 * Pin macros (RK_PB2, RK_PB5, RK_PA6, RK_PB6, RK_PD0, RK_FUNC_GPIO)
                 * come from dt-bindings/pinctrl/rockchip.h and require CPP
                 * preprocessing before dtc.
                 *
                 * Format: <bank RK_Pxy RK_FUNC_GPIO &pull_config>
                 */
                rockchip,pins =
                    /* SPI Clock - UART5_CTSN */
                    <3 RK_PB2 RK_FUNC_GPIO &pcfg_pull_none>,
                    /* SPI MOSI - UART5_RTSN */
                    <3 RK_PB5 RK_FUNC_GPIO &pcfg_pull_none>,
                    /* SPI MISO - SAI2_SDI_M0 */
                    <3 RK_PA6 RK_FUNC_GPIO &pcfg_pull_none>,
                    /* DIO1 - Interrupt input (pull-down for edge detection) */
                    <3 RK_PB6 RK_FUNC_GPIO &pcfg_pull_down>,
                    /* BUSY - Status input */
                    <1 RK_PD0 RK_FUNC_GPIO &pcfg_pull_down>;
            };
        };
    };
};
