/dts-v1/;
/plugin/;

/*
 * Device tree overlay for PicoCalc M0 delta-sigma audio
 *
 * Enables the RK3506 Cortex-M0 remoteproc with M0 audio firmware and the
 * picocalc,snd-m0 sound device. Bit-bangs GPIO4_B2/B3 (Lyra pins 31/32,
 * RK3506 pins 138/139). Hardware PWM audio uses GPIO0_B4/B5 (Lyra pins 4/5,
 * RK3506 pins 12/13) instead.
 *
 * snd_pins is in picocalc-luckfox-lyra.dtsi (base DTB). This overlay adds
 * the sound and remoteproc devices and describes the ring they share.
 *
 * GPIO4_B2/B3 are 1.8 V pads. They reach the speaker/headphone path through
 * an NC7WZ16 buffer powered from AXP2101 ALDO4, which passes the 1.8 V signal
 * at the stock ALDO4 setting (tested; the margin is discussed in
 * luckfox-lyra/docs/m0-audio.md).
 *
 * To apply at runtime:
 *   mkdir -p /sys/kernel/config/device-tree/overlays/m0-audio
 *   cat /lib/firmware/overlays/m0-audio.dtbo > /sys/kernel/config/device-tree/overlays/m0-audio/dtbo
 *   echo 1 > /sys/kernel/config/device-tree/overlays/m0-audio/status
 *
 * To remove:
 *   echo 0 > /sys/kernel/config/device-tree/overlays/m0-audio/status
 *   rmdir /sys/kernel/config/device-tree/overlays/m0-audio
 */

/ {
    compatible = "rockchip,rk3506";

    fragment@0 {
        target-path = "/";
        __overlay__ {
            /* Header + ring shared with the M0: system SRAM, in the first
             * bank past the 4 KB OP-TEE keeps (the address is fixed in the
             * firmware, shmem.h). That bank stays reachable from Linux in
             * TCM mode. Not DDR, so there is nothing to reserve; the node
             * only gives the driver its address. */
            m0_ring: m0-ring@fff81000 {
                reg = <0xfff81000 0x3000>;
            };

            picocalc_snd_m0: picocalc-snd-m0 {
                compatible = "picocalc,snd-m0";
                status = "okay";
                memory-region = <&m0_ring>;
                remote-proc = <&mcu_rproc>;
                ring-buffer-bytes = <8192>;
                /* 74 = HCLK_M0, the M0 core clock its SysTick counts: the
                 * driver derives the tick timing from its rate. */
                clocks = <&cru 74>;
                /* Output bit rate; see tick_hz in the driver, which makes
                 * the tick an even number of core cycles: 62 at a 187.5 MHz
                 * core clock, the shortest at which the firmware still
                 * interpolates between samples. That needs the firmware
                 * running as TCM (rockchip,tcm below); without, use
                 * 1000000. A PROFILE=1 firmware needs 2929688 or less. */
                tick-rate-hz = <3000000>;
                pinctrl-names = "default";
                pinctrl-0 = <&snd_pins>;
            };

            mcu_rproc: mcu@fff84000 {
                compatible = "rockchip,rk3506-mcu";
                reg = <0xfff84000 0x8000>;
                firmware-name = "rk3506-m0-audio.elf";
                /* Run the firmware as tightly-coupled memory: 2.5 times
                 * the speed, hence the higher bit rate. The firmware can
                 * then not be loaded again until the next reboot (the driver
                 * keeps it running between streams). Remove this and lower
                 * tick-rate-hz to reload firmware freely while developing. */
                rockchip,tcm;
                /* Vendor 6.1 CRU IDs: 74 HCLK_M0 (must stay first: the
                 * driver reports its rate as the M0 core clock), 104
                 * STCLK_M0. The firmware's tick is the core's own SysTick,
                 * so no TIMER0 clocks are needed.
                 * Resets: 90 SRST_H_M0, 91 SRST_M0_JTAG,
                 * 10 SRST_HRESETN_M0_AC. Mainline numbers these differently. */
                clocks = <&cru 74>, <&cru 104>;
                resets = <&cru 90>, <&cru 91>,
                         <&cru 10>;
                reset-names = "h_m0", "m0_jtag", "hresetn_m0_ac";
            };
        };
    };
};
