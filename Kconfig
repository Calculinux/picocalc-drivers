## Kconfig
```kconfig
menuconfig STAGING_PICOCALC
    bool "Picocalc staging drivers"
    default n
    help
      This option enables the drivers necessary to support the clockwork
      picocalc, e.g. keyboard and lcd drivers. These drivers were provided by
      hisptoot (https://github.com/hisptoot/picocalc_luckfox_lyra).

if STAGING_PICOCALC

source "drivers/staging/picocalc/drivers/picocalc_kbd/Kconfig"
source "drivers/staging/picocalc/drivers/picocalc_lcd_fb/Kconfig"
source "drivers/staging/picocalc/drivers/picocalc_lcd_drm/Kconfig"
source "drivers/staging/picocalc/drivers/picocalc_snd-pwm/Kconfig"
source "drivers/staging/picocalc/drivers/picocalc_snd-softpwm/Kconfig"
source "drivers/staging/picocalc/drivers/picocalc_mfd/Kconfig"
source "drivers/staging/picocalc/drivers/picocalc_mfd_bms/Kconfig"
source "drivers/staging/picocalc/drivers/picocalc_mfd_bkl/Kconfig"
source "drivers/staging/picocalc/drivers/picocalc_mfd_kbd/Kconfig"
source "drivers/staging/picocalc/drivers/picocalc_mfd_led/Kconfig"
source "drivers/staging/picocalc/luckfox-lyra/drivers/picocalc_rk3506_rproc/Kconfig"
source "drivers/staging/picocalc/luckfox-lyra/drivers/picocalc_snd-m0/Kconfig"

endif
```

## drivers/picocalc_kbd/Kconfig
```kconfig
# SPDX-License-Identifier: GPL-2.0
config PICOCALC_KBD
	tristate "Picocalc Keyboard support"
	help

	  Say Y or M here if you want to use the picocalc keyboard. The module will be called picocalc_kbd.
```

## drivers/picocalc_lcd_drm/Kconfig
```kconfig
# SPDX-License-Identifier: GPL-2.0-only

config PICOCALC_LCD_DRM
	tristate "PicoCalc TinyDRM LCD driver"
	depends on DRM && DRM_KMS_HELPER && DRM_MIPI_DBI && SPI
	depends on BACKLIGHT_CLASS_DEVICE || BACKLIGHT_CLASS_DEVICE=n
	select DRM_GEM_DMA_HELPER
	help
	  Enable the TinyDRM-based driver for the PicoCalc ILI9488 SPI
	  panel. This provides a DRM/KMS interface (via mipi-dbi) so
	  userspace can use the kmsdrm backend instead of the legacy
	  framebuffer driver.
```

## drivers/picocalc_lcd_fb/Kconfig
```kconfig
# SPDX-License-Identifier: GPL-2.0
config PICOCALC_LCD_FB
    tristate "Picocalc screen support (fbdev)"
    help

      Say Y or M here if you want to use the picocalc lcd screen with a framebuffer only driver. The module will be called ili9488_fb.
```

## drivers/picocalc_snd-pwm/Kconfig
```kconfig
# SPDX-License-Identifier: GPL-2.0
config PICOCALC_SND_PWM
    tristate "Picocalc pwm support"
    help
      Say Y or M here if you want to use the picocalc pwm. The module will be called picocalc_snd_pwm.
```

## drivers/picocalc_snd-softpwm/Kconfig
```kconfig
# SPDX-License-Identifier: GPL-2.0
config PICOCALC_SND_SOFT_PWM
    tristate "Picocalc soft pwm support"
    help
      Say Y or M here if you want to use the picocalc soft pwm. The module will be called picocalc_pwm.
```

## luckfox-lyra/drivers/picocalc_rk3506_rproc/Kconfig
```kconfig
# SPDX-License-Identifier: GPL-2.0
config PICOCALC_RK3506_RPROC
	tristate "RK3506 Cortex-M0 remoteproc support"
	depends on REMOTEPROC && (ARM || ARM64)
	help
	  Say M here to build the remoteproc driver for the RK3506 Cortex-M0
	  core. Required for M0-based audio (picocalc,snd-m0). Port of
	  nvitya/rk3506-mcu with ELF boot address support for 0xFFF88000.
```

## luckfox-lyra/drivers/picocalc_snd-m0/Kconfig
```kconfig
# SPDX-License-Identifier: GPL-2.0
config PICOCALC_SND_M0
	tristate "PicoCalc M0 delta-sigma audio support"
	depends on STAGING_PICOCALC && REMOTEPROC
	help
	  Say M here for M0-driven delta-sigma audio on GPIO4_B2/B3 (same pins
	  as softpwm). Requires rk3506_rproc and rk3506-m0-audio.elf firmware.
```
